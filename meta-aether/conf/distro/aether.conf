## meta-aether/conf/distro/aether.conf
```bitbake
require conf/distro/poky.conf

DISTRO = "aether"
DISTRO_NAME = "Aether OS"
DISTRO_VERSION = "0.1"

DISTRO_FEATURES:append = " wayland opengl systemd"
VIRTUAL-RUNTIME_init_manager = "systemd"
DISTRO_FEATURES_BACKFILL_CONSIDERED = "sysvinit"
```

## meta-aether/conf/layer.conf
```bitbake
# Aether OS Yocto layer
BBPATH .= ":${LAYERDIR}"
BBFILES += "${LAYERDIR}/recipes-*/*/*.bb"

BBFILE_COLLECTIONS += "aether"
BBFILE_PATTERN_aether = "^${LAYERDIR}/"
BBFILE_PRIORITY_aether = "8"

LAYERSERIES_COMPAT_aether = "wrynose"
```
